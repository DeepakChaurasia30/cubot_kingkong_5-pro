/dts-v1/;

/ {

	__fixups__ {
		accdet = "/fragment@9:target:0", "/fragment@57:target:0";
		audgpio = "/fragment@13:target:0";
		auxadc = "/fragment@37:target:0", "/fragment@38/__overlay__:io-channels:0";
		charger = "/fragment@20:target:0";
		chosen = "/fragment@0:target:0", "/fragment@20/__overlay__:bootmode:0";
		consys = "/fragment@5:target:0";
		dsi_te = "/fragment@62:target:0";
		flashlights_mt6370 = "/fragment@26:target:0";
		goodix_fp = "/fragment@34:target:0", "/fragment@56:target:0";
		gpio = "/fragment@51:target:0";
		gpio_usage_mapping = "/fragment@50:target:0";
		i2c0 = "/fragment@40:target:0";
		i2c1 = "/fragment@41:target:0";
		i2c2 = "/fragment@42:target:0";
		i2c3 = "/fragment@2:target:0", "/fragment@27:target:0", "/fragment@43:target:0";
		i2c4 = "/fragment@44:target:0";
		i2c5 = "/fragment@45:target:0";
		i2c6 = "/fragment@3:target:0", "/fragment@28:target:0", "/fragment@46:target:0";
		i2c7 = "/fragment@47:target:0";
		i2c8 = "/fragment@48:target:0";
		i2c9 = "/fragment@49:target:0";
		irq_nfc = "/fragment@58:target:0";
		irtx_pwm = "/fragment@11:target:0";
		kd_camera_hw1 = "/fragment@25:target:0", "/fragment@71:target:0";
		keypad = "/fragment@6:target:0", "/fragment@73:target:0";
		main_pmic = "/fragment@8:target:0", "/fragment@20/__overlay__:pmic:0", "/fragment@63:target:0";
		md1_sim1_hot_plug_eint = "/fragment@64:target:0";
		md_auxadc = "/fragment@38:target:0";
		mrdump_ext_rst = "/fragment@54:target:0";
		msdc1 = "/fragment@29:target:0";
		msdc1_ins = "/fragment@53:target:0";
		mt6370_chg = "/fragment@19:target:0", "/fragment@20/__overlay__:charger:0";
		mt6370_pmu = "/fragment@17:target:0";
		mt6370_typec = "/fragment@18:target:0";
		mt_pmic_vcama_ldo_reg = "/fragment@25/__overlay__:cam0_vcama-supply:0", "/fragment@25/__overlay__:cam1_vcama-supply:0", "/fragment@25/__overlay__:cam2_vcama-supply:0", "/fragment@25/__overlay__:cam3_vcama-supply:0", "/fragment@65:target:0", "/fragment@71/__overlay__:vcama-supply:0";
		mt_pmic_vcamd_ldo_reg = "/fragment@25/__overlay__:cam0_vcamd-supply:0", "/fragment@25/__overlay__:cam1_vcamd-supply:0", "/fragment@25/__overlay__:cam2_vcamd-supply:0", "/fragment@25/__overlay__:cam3_vcamd-supply:0", "/fragment@68:target:0", "/fragment@71/__overlay__:vcamd_main2-supply:0";
		mt_pmic_vcamio_ldo_reg = "/fragment@25/__overlay__:cam0_vcamio-supply:0", "/fragment@25/__overlay__:cam1_vcamio-supply:0", "/fragment@25/__overlay__:cam2_vcamio-supply:0", "/fragment@25/__overlay__:cam3_vcamio-supply:0", "/fragment@69:target:0", "/fragment@71/__overlay__:vcamio-supply:0", "/fragment@71/__overlay__:vcamio_sub-supply:0", "/fragment@71/__overlay__:vcamio_main2-supply:0";
		mt_pmic_vldo28_ldo_reg = "/fragment@34/__overlay__:vfingerprint-supply:0", "/fragment@70:target:0", "/fragment@71/__overlay__:vcamaf-supply:0", "/fragment@71/__overlay__:vcamaf_sub-supply:0", "/fragment@71/__overlay__:vcamaf_main2-supply:0", "/fragment@72/__overlay__:vtouch-supply:0";
		mt_pmic_vsim1_ldo_reg = "/fragment@66:target:0";
		mt_pmic_vsim2_ldo_reg = "/fragment@67:target:0";
		mtk_gauge = "/fragment@20/__overlay__:gauge:0", "/fragment@36:target:0";
		nfc = "/fragment@30:target:0";
		odm = "/fragment@1:target:0";
		pdc = "/fragment@22:target:0";
		pe2 = "/fragment@21:target:0";
		pe4 = "/fragment@23:target:0";
		pio = "/fragment@4:target:0", "/fragment@7:target:0", "/fragment@8/__overlay__/pmic_accdet:gpio_mic_switch_pin:0", "/fragment@8/__overlay__/pmic_accdet:gpio_headset_usb_switch_pin:0", "/fragment@10:target:0", "/fragment@12:target:0", "/fragment@14:target:0", "/fragment@16:target:0", "/fragment@17/__overlay__:mt6370,intr_gpio:0", "/fragment@18/__overlay__:mt6370pd,intr_gpio:0", "/fragment@24:target:0", "/fragment@29/__overlay__:cd-gpios:0", "/fragment@30/__overlay__:gpio-rst-std:0", "/fragment@30/__overlay__:gpio-irq-std:0", "/fragment@31:target:0", "/fragment@32/__overlay__:reportkey_eint_pin:0", "/fragment@33/__overlay__/fingerprint@0:fingerprint,touch-int-gpio:0", "/fragment@35:target:0", "/fragment@50/__overlay__:GPIO_SIM2_SIO:0", "/fragment@50/__overlay__:GPIO_SIM2_SRST:0", "/fragment@50/__overlay__:GPIO_SIM2_SCLK:0", "/fragment@50/__overlay__:GPIO_SIM1_SCLK:0", "/fragment@50/__overlay__:GPIO_SIM1_SRST:0", "/fragment@50/__overlay__:GPIO_SIM1_SIO:0", "/fragment@50/__overlay__:GPIO_SIM1_HOT_PLUG:0", "/fragment@50/__overlay__:GPIO_FDD_BAND_SUPPORT_DETECT_3RD_PIN:0", "/fragment@50/__overlay__:GPIO_FDD_BAND_SUPPORT_DETECT_2ND_PIN:0", "/fragment@50/__overlay__:GPIO_FDD_BAND_SUPPORT_DETECT_1ST_PIN:0", "/fragment@52/__overlay__:interrupt-parent:0", "/fragment@53/__overlay__:interrupt-parent:0", "/fragment@54/__overlay__:interrupt-parent:0", "/fragment@54/__overlay__:deb-gpios:0", "/fragment@55/__overlay__:interrupt-parent:0", "/fragment@56/__overlay__:interrupt-parent:0", "/fragment@57/__overlay__:interrupt-parent:0", "/fragment@57/__overlay__:deb-gpios:0", "/fragment@58/__overlay__:interrupt-parent:0", "/fragment@59/__overlay__:interrupt-parent:0", "/fragment@60/__overlay__:interrupt-parent:0", "/fragment@61/__overlay__:interrupt-parent:0", "/fragment@62/__overlay__:interrupt-parent:0", "/fragment@63/__overlay__:interrupt-parent:0";
		pmic_clock_buffer_ctrl = "/fragment@39:target:0";
		reportkey = "/fragment@32:target:0", "/fragment@55:target:0";
		rt9465_slave_chr = "/fragment@60:target:0";
		spi0 = "/fragment@33:target:0";
		subpmic_pmu_eint = "/fragment@59:target:0";
		tcpc_pd = "/fragment@61:target:0";
		touch = "/fragment@15:target:0", "/fragment@52:target:0", "/fragment@72:target:0";
	};

	__local_fixups__ {

		fragment@11 {

			__overlay__ {
				pinctrl-0 = <0x0>;
				pinctrl-1 = <0x0>;
			};
		};

		fragment@13 {

			__overlay__ {
				pinctrl-0 = <0x0>;
				pinctrl-1 = <0x0>;
				pinctrl-2 = <0x0>;
				pinctrl-3 = <0x0>;
				pinctrl-4 = <0x0>;
				pinctrl-5 = <0x0>;
				pinctrl-6 = <0x0>;
				pinctrl-7 = <0x0>;
				pinctrl-8 = <0x0>;
				pinctrl-9 = <0x0>;
			};
		};

		fragment@15 {

			__overlay__ {
				pinctrl-0 = <0x0>;
				pinctrl-1 = <0x0>;
				pinctrl-2 = <0x0>;
				pinctrl-3 = <0x0>;
				pinctrl-4 = <0x0>;
				pinctrl-5 = <0x0>;
			};
		};

		fragment@25 {

			__overlay__ {
				pinctrl-0 = <0x0>;
				pinctrl-1 = <0x0>;
				pinctrl-10 = <0x0>;
				pinctrl-11 = <0x0>;
				pinctrl-12 = <0x0>;
				pinctrl-13 = <0x0>;
				pinctrl-14 = <0x0>;
				pinctrl-15 = <0x0>;
				pinctrl-16 = <0x0>;
				pinctrl-17 = <0x0>;
				pinctrl-18 = <0x0>;
				pinctrl-19 = <0x0>;
				pinctrl-2 = <0x0>;
				pinctrl-20 = <0x0>;
				pinctrl-21 = <0x0>;
				pinctrl-22 = <0x0>;
				pinctrl-23 = <0x0>;
				pinctrl-24 = <0x0>;
				pinctrl-25 = <0x0>;
				pinctrl-26 = <0x0>;
				pinctrl-27 = <0x0>;
				pinctrl-28 = <0x0>;
				pinctrl-29 = <0x0>;
				pinctrl-3 = <0x0>;
				pinctrl-30 = <0x0>;
				pinctrl-31 = <0x0>;
				pinctrl-32 = <0x0>;
				pinctrl-33 = <0x0>;
				pinctrl-34 = <0x0>;
				pinctrl-4 = <0x0>;
				pinctrl-5 = <0x0>;
				pinctrl-6 = <0x0>;
				pinctrl-7 = <0x0>;
				pinctrl-8 = <0x0>;
				pinctrl-9 = <0x0>;
			};
		};

		fragment@32 {

			__overlay__ {
				pinctrl-0 = <0x0>;
				pinctrl-1 = <0x0>;
			};
		};

		fragment@34 {

			__overlay__ {
				pinctrl-0 = <0x0>;
				pinctrl-1 = <0x0>;
				pinctrl-2 = <0x0>;
				pinctrl-3 = <0x0>;
				pinctrl-4 = <0x0>;
				pinctrl-5 = <0x0>;
				pinctrl-6 = <0x0>;
				pinctrl-7 = <0x0>;
			};
		};

		fragment@5 {

			__overlay__ {
				pinctrl-0 = <0x0>;
				pinctrl-1 = <0x0>;
				pinctrl-2 = <0x0>;
				pinctrl-3 = <0x0>;
			};
		};

		fragment@6 {

			__overlay__ {
				pinctrl-0 = <0x0>;
			};
		};

		fragment@9 {

			__overlay__ {
				pinctrl-0 = <0x0>;
				pinctrl-1 = <0x0>;
			};
		};
	};

	__symbols__ {
		accdet_pins_default = "/fragment@10/__overlay__/accdetdefault";
		accdet_pins_eint_as_int = "/fragment@10/__overlay__/accdeteint@0";
		aud_clk_miso_off = "/fragment@14/__overlay__/aud_clk_miso_off";
		aud_clk_miso_on = "/fragment@14/__overlay__/aud_clk_miso_on";
		aud_clk_mosi_off = "/fragment@14/__overlay__/aud_clk_mosi_off";
		aud_clk_mosi_on = "/fragment@14/__overlay__/aud_clk_mosi_on";
		aud_dat_miso_off = "/fragment@14/__overlay__/aud_dat_miso_off";
		aud_dat_miso_on = "/fragment@14/__overlay__/aud_dat_miso_on";
		aud_dat_mosi_off = "/fragment@14/__overlay__/aud_dat_mosi_off";
		aud_dat_mosi_on = "/fragment@14/__overlay__/aud_dat_mosi_on";
		aud_pins_smartpa_off = "/fragment@14/__overlay__/aud_pins_smartpa_off";
		aud_pins_smartpa_on = "/fragment@14/__overlay__/aud_pins_smartpa_on";
		camera_main_af_mtk = "/fragment@42/__overlay__/camera_main_af@0c";
		camera_main_eeprom_mtk = "/fragment@42/__overlay__/camera_main_eeprom@50";
		camera_main_mtk = "/fragment@42/__overlay__/camera_main@1a";
		camera_main_two_af_mtk = "/fragment@42/__overlay__/camera_main_two_af@1c";
		camera_main_two_eeprom_mtk = "/fragment@42/__overlay__/camera_main_two_eeprom@60";
		camera_main_two_mtk = "/fragment@42/__overlay__/camera_main_two@2d";
		camera_pins_cam0_mclk_off = "/fragment@24/__overlay__/camera_pins_cam0_mclk_off";
		camera_pins_cam0_mclk_on = "/fragment@24/__overlay__/camera_pins_cam0_mclk_on";
		camera_pins_cam0_pnd0 = "/fragment@24/__overlay__/cam0@2";
		camera_pins_cam0_pnd1 = "/fragment@24/__overlay__/cam0@3";
		camera_pins_cam0_rst0 = "/fragment@24/__overlay__/cam0@0";
		camera_pins_cam0_rst1 = "/fragment@24/__overlay__/cam0@1";
		camera_pins_cam1_mclk_off = "/fragment@24/__overlay__/camera_pins_cam1_mclk_off";
		camera_pins_cam1_mclk_on = "/fragment@24/__overlay__/camera_pins_cam1_mclk_on";
		camera_pins_cam1_pnd0 = "/fragment@24/__overlay__/cam1@2";
		camera_pins_cam1_pnd1 = "/fragment@24/__overlay__/cam1@3";
		camera_pins_cam1_rst0 = "/fragment@24/__overlay__/cam1@0";
		camera_pins_cam1_rst1 = "/fragment@24/__overlay__/cam1@1";
		camera_pins_cam2_mclk_off = "/fragment@24/__overlay__/camera_pins_cam2_mclk_off";
		camera_pins_cam2_mclk_on = "/fragment@24/__overlay__/camera_pins_cam2_mclk_on";
		camera_pins_cam2_pnd0 = "/fragment@24/__overlay__/cam2@2";
		camera_pins_cam2_pnd1 = "/fragment@24/__overlay__/cam2@3";
		camera_pins_cam2_rst0 = "/fragment@24/__overlay__/cam2@0";
		camera_pins_cam2_rst1 = "/fragment@24/__overlay__/cam2@1";
		camera_pins_cam3_mclk_off = "/fragment@24/__overlay__/camera_pins_cam3_mclk_off";
		camera_pins_cam3_mclk_on = "/fragment@24/__overlay__/camera_pins_cam3_mclk_on";
		camera_pins_cam3_pnd0 = "/fragment@24/__overlay__/cam3@2";
		camera_pins_cam3_pnd1 = "/fragment@24/__overlay__/cam3@3";
		camera_pins_cam3_rst0 = "/fragment@24/__overlay__/cam3@0";
		camera_pins_cam3_rst1 = "/fragment@24/__overlay__/cam3@1";
		camera_pins_cam_af0 = "/fragment@24/__overlay__/camaf@0";
		camera_pins_cam_af1 = "/fragment@24/__overlay__/camaf@1";
		camera_pins_cam_ldo_rear2_vcama_0 = "/fragment@24/__overlay__/cam2@vcama0";
		camera_pins_cam_ldo_rear2_vcama_1 = "/fragment@24/__overlay__/cam2@vcama1";
		camera_pins_cam_ldo_rear_vcamd_0 = "/fragment@24/__overlay__/cam0@vcamd0";
		camera_pins_cam_ldo_rear_vcamd_1 = "/fragment@24/__overlay__/cam0@vcamd1";
		camera_pins_cam_ldo_sub_vcama_0 = "/fragment@24/__overlay__/cam1@vcama0";
		camera_pins_cam_ldo_sub_vcama_1 = "/fragment@24/__overlay__/cam1@vcama1";
		camera_pins_cam_ldo_sub_vcamd_0 = "/fragment@24/__overlay__/cam1@vcamd0";
		camera_pins_cam_ldo_sub_vcamd_1 = "/fragment@24/__overlay__/cam1@vcamd1";
		camera_pins_default = "/fragment@24/__overlay__/camdefault";
		camera_sub_eeprom_mtk = "/fragment@44/__overlay__/camera_sub_eeprom@52";
		camera_sub_mtk = "/fragment@44/__overlay__/camera_sub@2d";
		camera_sub_two_mtk = "/fragment@44/__overlay__/camera_sub_two@22";
		cap_touch_mtk = "/fragment@40/__overlay__/cap_touch@5d";
		ccu_sensor_i2c_2_hw_mtk = "/fragment@42/__overlay__/ccu_sensor_i2c_2_hw@10";
		ccu_sensor_i2c_4_hw_mtk = "/fragment@44/__overlay__/ccu_sensor_i2c_4_hw@11";
		consys_pins_default = "/fragment@4/__overlay__/consys_default";
		ctp_pins_default = "/fragment@16/__overlay__/eint0default";
		ctp_pins_eint_as_int = "/fragment@16/__overlay__/eint@0";
		ctp_pins_eint_output0 = "/fragment@16/__overlay__/eintoutput0";
		ctp_pins_eint_output1 = "/fragment@16/__overlay__/eintoutput1";
		ctp_pins_rst_output0 = "/fragment@16/__overlay__/rstoutput0";
		ctp_pins_rst_output1 = "/fragment@16/__overlay__/rstoutput1";
		ext_buck_lp4_mtk = "/fragment@43/__overlay__/ext_buck_lp4@57";
		ext_buck_lp4x_mtk = "/fragment@43/__overlay__/ext_buck_lp4x@50";
		ext_buck_vgpu_mtk = "/fragment@46/__overlay__/ext_buck_vgpu@55";
		fingerprint_default = "/fragment@35/__overlay__/state_default";
		fingerprint_eint = "/fragment@35/__overlay__/state_spi_eint_init";
		fingerprint_reset_high = "/fragment@35/__overlay__/state_spi_rst_high";
		fingerprint_reset_low = "/fragment@35/__overlay__/state_spi_rst_low";
		fingerprint_spi_clk = "/fragment@35/__overlay__/state_spi_ck_init";
		fingerprint_spi_cs = "/fragment@35/__overlay__/state_spi_cs_init";
		fingerprint_spi_mi = "/fragment@35/__overlay__/state_spi_miso_init";
		fingerprint_spi_mo = "/fragment@35/__overlay__/state_spi_mosi_init";
		gpslna_pins_init = "/fragment@4/__overlay__/gpslna@0";
		gpslna_pins_oh = "/fragment@4/__overlay__/gpslna@1";
		gpslna_pins_ol = "/fragment@4/__overlay__/gpslna@2";
		irtx_gpio_led_default = "/fragment@12/__overlay__/irtx_gpio_led_def@gpio90";
		irtx_gpio_led_set = "/fragment@12/__overlay__/irtx_gpio_led_set@gpio90";
		kpd_pins_default = "/fragment@7/__overlay__/kpdgpiodefault";
		led0 = "/fragment@1/__overlay__/led@0";
		led1 = "/fragment@1/__overlay__/led@1";
		led2 = "/fragment@1/__overlay__/led@2";
		led3 = "/fragment@1/__overlay__/led@3";
		led4 = "/fragment@1/__overlay__/led@4";
		led5 = "/fragment@1/__overlay__/led@5";
		led6 = "/fragment@1/__overlay__/led@6";
		nfc_mtk = "/fragment@43/__overlay__/nfc@08";
		pmic_accdet = "/fragment@8/__overlay__/pmic_accdet";
		reportkey_pins_default = "/fragment@31/__overlay__/pins_default";
		reportkey_pins_eint_as_int = "/fragment@31/__overlay__/pins_cfg";
		slave_charger_mtk = "/fragment@43/__overlay__/slave_charger@4b";
		speaker_amp_mtk = "/fragment@43/__overlay__/speaker_amp@34";
		subpmic_pmu_mtk = "/fragment@45/__overlay__/subpmic_pmu@34";
		usb_type_c_mtk = "/fragment@45/__overlay__/usb_type_c@4e";
		vibrator0 = "/fragment@1/__overlay__/vibrator@0";
	};

	fragment@0 {
		target = <0xffffffff>;

		__overlay__ {
			atag,videolfb-fb_base_h = <0x0>;
			atag,videolfb-fb_base_l = "^`P";
			atag,videolfb-fps = <0x1770>;
			atag,videolfb-islcm_inited = <0x0>;
			atag,videolfb-islcmfound = <0x1>;
			atag,videolfb-lcmname = "nt35695B_fhd_dsi_cmd_auo_rt5081_drv";
			atag,videolfb-vramSize = <0x17bb000>;
		};
	};

	fragment@1 {
		target = <0xffffffff>;

		__overlay__ {

			led@0 {
				compatible = "mediatek,red";
				data = <0x3>;
				led_mode = <0x6>;
				phandle = <0x47>;
				pwm_config = <0x0 0x0 0x0 0x0 0x0>;
			};

			led@1 {
				compatible = "mediatek,green";
				data = <0x3>;
				led_mode = <0x6>;
				phandle = <0x48>;
				pwm_config = <0x0 0x0 0x0 0x0 0x0>;
			};

			led@2 {
				compatible = "mediatek,blue";
				data = <0x3>;
				led_mode = <0x6>;
				phandle = <0x49>;
				pwm_config = <0x0 0x0 0x0 0x0 0x0>;
			};

			led@3 {
				compatible = "mediatek,jogball-backlight";
				data = <0x1>;
				led_mode = <0x0>;
				phandle = <0x4a>;
				pwm_config = <0x0 0x0 0x0 0x0 0x0>;
			};

			led@4 {
				compatible = "mediatek,keyboard-backlight";
				data = <0x1>;
				led_mode = <0x0>;
				phandle = <0x4b>;
				pwm_config = <0x0 0x0 0x0 0x0 0x0>;
			};

			led@5 {
				compatible = "mediatek,button-backlight";
				data = <0x1>;
				led_mode = <0x0>;
				phandle = <0x4c>;
				pwm_config = <0x0 0x0 0x0 0x0 0x0>;
			};

			led@6 {
				compatible = "mediatek,lcd-backlight";
				data = <0x1>;
				led_mode = <0x5>;
				phandle = <0x4d>;
				pwm_config = <0x0 0x3 0x0 0x0 0x0>;
			};

			vibrator@0 {
				compatible = "mediatek,vibrator";
				phandle = <0x4e>;
				vib_limit = <0x9>;
				vib_timer = <0x19>;
				vib_vol = <0x9>;
			};
		};
	};

	fragment@10 {
		target = <0xffffffff>;

		__overlay__ {

			accdetdefault {
				phandle = <0x6>;
			};

			accdeteint@0 {
				phandle = <0x7>;
			};
		};
	};

	fragment@11 {
		target = <0xffffffff>;

		__overlay__ {
			pinctrl-0 = <0x8>;
			pinctrl-1 = <0x9>;
			pinctrl-names = "irtx_gpio_led_default", "irtx_gpio_led_set";
			status = "okay";
		};
	};

	fragment@12 {
		target = <0xffffffff>;

		__overlay__ {

			irtx_gpio_led_def@gpio90 {
				phandle = <0x8>;

				pins_cmd_dat {
					bias-disable;
					input-schmitt-enable = <0x0>;
					output-low;
					pinmux = <0x5a00>;
					slew-rate = <0x1>;
				};
			};

			irtx_gpio_led_set@gpio90 {
				phandle = <0x9>;

				pins_cmd_dat {
					output-high;
					pinmux = <0x5a02>;
					slew-rate = <0x1>;
				};
			};
		};
	};

	fragment@13 {
		target = <0xffffffff>;

		__overlay__ {
			pinctrl-0 = <0xa>;
			pinctrl-1 = <0xb>;
			pinctrl-2 = <0xc>;
			pinctrl-3 = <0xd>;
			pinctrl-4 = <0xe>;
			pinctrl-5 = <0xf>;
			pinctrl-6 = <0x10>;
			pinctrl-7 = <0x11>;
			pinctrl-8 = <0x12>;
			pinctrl-9 = <0x13>;
			pinctrl-names = "aud_clk_mosi_off", "aud_clk_mosi_on", "aud_clk_miso_off", "aud_clk_miso_on", "aud_dat_mosi_off", "aud_dat_mosi_on", "aud_dat_miso_off", "aud_dat_miso_on", "aud_smartpa_off", "aud_smartpa_on";
			status = "okay";
		};
	};

	fragment@14 {
		target = <0xffffffff>;

		__overlay__ {

			aud_clk_miso_off {
				phandle = <0xc>;

				pins_cmd0_dat {
					pinmux = <0x8c00>;
				};
			};

			aud_clk_miso_on {
				phandle = <0xd>;

				pins_cmd0_dat {
					pinmux = <0x8c01>;
				};
			};

			aud_clk_mosi_off {
				phandle = <0xa>;

				pins_cmd0_dat {
					pinmux = <0x8800>;
				};
			};

			aud_clk_mosi_on {
				phandle = <0xb>;

				pins_cmd0_dat {
					pinmux = <0x8801>;
				};
			};

			aud_dat_miso_off {
				phandle = <0x10>;

				pins_cmd1_dat {
					bias-disable;
					input-enable;
					pinmux = <0x8e00>;
					slew-rate = <0x0>;
				};

				pins_cmd2_dat {
					bias-disable;
					input-enable;
					pinmux = <0x8f00>;
					slew-rate = <0x0>;
				};
			};

			aud_dat_miso_on {
				phandle = <0x11>;

				pins_cmd1_dat {
					pinmux = <0x8e01>;
				};

				pins_cmd2_dat {
					pinmux = <0x8f01>;
				};
			};

			aud_dat_mosi_off {
				phandle = <0xe>;

				pins_cmd1_dat {
					bias-disable;
					input-enable;
					pinmux = <0x8a00>;
					slew-rate = <0x0>;
				};

				pins_cmd2_dat {
					bias-disable;
					input-enable;
					pinmux = <0x8b00>;
					slew-rate = <0x0>;
				};
			};

			aud_dat_mosi_on {
				phandle = <0xf>;

				pins_cmd1_dat {
					pinmux = <0x8a01>;
				};

				pins_cmd2_dat {
					pinmux = <0x8b01>;
				};
			};

			aud_pins_smartpa_off {
				phandle = <0x12>;

				pins_cmd0_dat {
					pinmux = <0x1100>;
				};

				pins_cmd1_dat {
					pinmux = <0x1200>;
				};

				pins_cmd2_dat {
					pinmux = <0x1300>;
				};

				pins_cmd3_dat {
					pinmux = <0x1400>;
				};
			};

			aud_pins_smartpa_on {
				phandle = <0x13>;

				pins_cmd0_dat {
					pinmux = <0x1106>;
				};

				pins_cmd1_dat {
					pinmux = <0x1206>;
				};

				pins_cmd2_dat {
					pinmux = <0x1306>;
				};

				pins_cmd3_dat {
					pinmux = <0x1406>;
				};
			};
		};
	};

	fragment@15 {
		target = <0xffffffff>;

		__overlay__ {
			pinctrl-0 = <0x14>;
			pinctrl-1 = <0x15>;
			pinctrl-2 = <0x16>;
			pinctrl-3 = <0x17>;
			pinctrl-4 = <0x18>;
			pinctrl-5 = <0x19>;
			pinctrl-names = "default", "state_eint_as_int", "state_eint_output0", "state_eint_output1", "state_rst_output0", "state_rst_output1";
			status = "okay";
			tpd-filter-custom-prameters = <0x0 0x0 0x0 0x0 0x0 0x0 0x0 0x0 0x0 0x0 0x0 0x0>;
			tpd-filter-custom-speed = <0x0 0x0 0x0>;
			tpd-filter-enable = <0x1>;
			tpd-filter-pixel-density = <0x6a>;
			tpd-key-dim-local = <0x5a 0x373 0x64 0x28 0xe6 0x373 0x64 0x28 0x172 0x373 0x64 0x28 0x0 0x0 0x0 0x0>;
			tpd-key-local = <0x8b 0xac 0x9e 0x0>;
			tpd-key-num = <0x3>;
			tpd-max-touch-num = <0x5>;
			tpd-resolution = <0x2d0 0x618>;
			use-tpd-button = <0x0>;
		};
	};

	fragment@16 {
		target = <0xffffffff>;

		__overlay__ {

			eint0default {
				phandle = <0x14>;
			};

			eint@0 {
				phandle = <0x15>;

				pins_cmd_dat {
					bias-disable;
					pinmux = <0x0>;
					slew-rate = <0x0>;
				};
			};

			eintoutput0 {
				phandle = <0x16>;

				pins_cmd_dat {
					output-low;
					pinmux = <0x0>;
					slew-rate = <0x1>;
				};
			};

			eintoutput1 {
				phandle = <0x17>;

				pins_cmd_dat {
					output-high;
					pinmux = <0x0>;
					slew-rate = <0x1>;
				};
			};

			rstoutput0 {
				phandle = <0x18>;

				pins_cmd_dat {
					output-low;
					pinmux = <0xae00>;
					slew-rate = <0x1>;
				};
			};

			rstoutput1 {
				phandle = <0x19>;

				pins_cmd_dat {
					output-high;
					pinmux = <0xae00>;
					slew-rate = <0x1>;
				};
			};
		};
	};

	fragment@17 {
		target = <0xffffffff>;

		__overlay__ {
			mt6370,intr_gpio = <0xffffffff 0xb 0x0>;
			mt6370,intr_gpio_num = <0xb>;

			bled {
				mt,max_bled_brightness = <0x2ad>;
			};
		};
	};

	fragment@18 {
		target = <0xffffffff>;

		__overlay__ {
			mt6370pd,intr_gpio = <0xffffffff 0x29 0x0>;
			mt6370pd,intr_gpio_num = <0x29>;
		};
	};

	fragment@19 {
		target = <0xffffffff>;

		__overlay__ {
			bc12_sel = <0x1>;
		};
	};

	fragment@2 {
		target = <0xffffffff>;

		__overlay__ {

			ext_buck_lp4@57 {
				regulator-max-microvolt = <0x13d620>;
				regulator-min-microvolt = <0x493e0>;
				regulator-name = "ext_buck_vdd2";
				vsel_pin = <0x0>;
			};

			ext_buck_lp4x@50 {
				regulator-max-microvolt = <0x13d620>;
				regulator-min-microvolt = <0x493e0>;
				regulator-name = "ext_buck_vddq";
				vsel_pin = <0x1>;
			};
		};
	};

	fragment@20 {
		target = <0xffffffff>;

		__overlay__ {
			ac_charger_current = <0x2dc6c0>;
			ac_charger_input_current = <0x2dc6c0>;
			algorithm_name = "Basic";
			battery_cv = <0x426030>;
			bootmode = <0xffffffff>;
			charger = <0xffffffff>;
			charger_configuration = <0x0>;
			charging_host_charger_current = <0x16e360>;
			compatible = "mediatek,charger";
			enable_dynamic_mivr;
			enable_min_charge_temp;
			gauge = <0xffffffff>;
			jeita_temp_above_t4_cv = <0x40b280>;
			jeita_temp_below_t0_cv = <0x3da540>;
			jeita_temp_t0_to_t1_cv = <0x3da540>;
			jeita_temp_t1_to_t2_cv = <0x40b280>;
			jeita_temp_t2_to_t3_cv = <0x423920>;
			jeita_temp_t3_to_t4_cv = <0x40b280>;
			max_charge_temp = <0x37>;
			max_charge_temp_minus_x_degree = <0x34>;
			max_charger_voltage = <0x632ea0>;
			max_dmivr_charger_current = <0x1b7740>;
			min_charge_temp = <0x0>;
			min_charge_temp_plus_x_degree = <0x6>;
			min_charger_voltage = <0x432380>;
			min_charger_voltage_1 = <0x432380>;
			min_charger_voltage_2 = <0x401640>;
			pmic = <0xffffffff>;
			temp_neg_10_thres = <0x0>;
			temp_t0_thres = <0x0>;
			temp_t0_thres_plus_x_degree = <0x0>;
			temp_t1_thres = <0x0>;
			temp_t1_thres_plus_x_degree = <0x6>;
			temp_t2_thres = <0xa>;
			temp_t2_thres_plus_x_degree = <0x10>;
			temp_t3_thres = <0x2d>;
			temp_t3_thres_minus_x_degree = <0x27>;
			temp_t4_thres = <0x32>;
			temp_t4_thres_minus_x_degree = <0x2f>;
			usb_charger_current = <0x7a120>;
		};
	};

	fragment@21 {
		target = <0xffffffff>;

		__overlay__ {
			dcs_chg1_charger_current = <0x1e8480>;
			dcs_chg2_charger_current = <0x1e8480>;
		};
	};

	fragment@22 {
		target = <0xffffffff>;

		__overlay__ {
			dcs_chg1_charger_current = <0x1e8480>;
			dcs_chg2_charger_current = <0x1e8480>;
			pd_vbus_upper_bound = <0xb71b00>;
		};
	};

	fragment@23 {
		target = <0xffffffff>;

		__overlay__ {
			dcs_chg1_charger_current = <0x1e8480>;
			dcs_chg2_charger_current = <0x1e8480>;
		};
	};

	fragment@24 {
		target = <0xffffffff>;

		__overlay__ {

			cam0@0 {
				phandle = <0x1b>;

				pins_cmd_dat {
					output-low;
					pinmux = <0x6500>;
					slew-rate = <0x1>;
				};
			};

			cam0@1 {
				phandle = <0x1c>;

				pins_cmd_dat {
					output-high;
					pinmux = <0x6500>;
					slew-rate = <0x1>;
				};
			};

			cam0@2 {
				phandle = <0x1d>;

				pins_cmd_dat {
					output-low;
					pinmux = <0x6100>;
					slew-rate = <0x1>;
				};
			};

			cam0@3 {
				phandle = <0x1e>;

				pins_cmd_dat {
					output-high;
					pinmux = <0x6100>;
					slew-rate = <0x1>;
				};
			};

			cam0@vcamd0 {
				phandle = <0x28>;
			};

			cam0@vcamd1 {
				phandle = <0x27>;
			};

			cam1@0 {
				phandle = <0x1f>;

				pins_cmd_dat {
					output-low;
					pinmux = <0x6600>;
					slew-rate = <0x1>;
				};
			};

			cam1@1 {
				phandle = <0x20>;

				pins_cmd_dat {
					output-high;
					pinmux = <0x6600>;
					slew-rate = <0x1>;
				};
			};

			cam1@2 {
				phandle = <0x21>;

				pins_cmd_dat {
					output-low;
					pinmux = <0x6200>;
					slew-rate = <0x1>;
				};
			};

			cam1@3 {
				phandle = <0x22>;

				pins_cmd_dat {
					output-high;
					pinmux = <0x6200>;
					slew-rate = <0x1>;
				};
			};

			cam1@vcama0 {
				phandle = <0x2c>;
			};

			cam1@vcama1 {
				phandle = <0x2b>;
			};

			cam1@vcamd0 {
				phandle = <0x2a>;
			};

			cam1@vcamd1 {
				phandle = <0x29>;
			};

			cam2@0 {
				phandle = <0x23>;

				pins_cmd_dat {
					output-low;
					pinmux = <0x6d00>;
					slew-rate = <0x1>;
				};
			};

			cam2@1 {
				phandle = <0x24>;

				pins_cmd_dat {
					output-high;
					pinmux = <0x6d00>;
					slew-rate = <0x1>;
				};
			};

			cam2@2 {
				phandle = <0x25>;

				pins_cmd_dat {
					output-low;
					pinmux = <0x6b00>;
					slew-rate = <0x1>;
				};
			};

			cam2@3 {
				phandle = <0x26>;

				pins_cmd_dat {
					output-high;
					pinmux = <0x6b00>;
					slew-rate = <0x1>;
				};
			};

			cam2@vcama0 {
				phandle = <0x2e>;
			};

			cam2@vcama1 {
				phandle = <0x2d>;
			};

			cam3@0 {
				phandle = <0x37>;

				pins_cmd_dat {
					output-low;
					pinmux = <0x5700>;
					slew-rate = <0x1>;
				};
			};

			cam3@1 {
				phandle = <0x38>;

				pins_cmd_dat {
					output-high;
					pinmux = <0x5700>;
					slew-rate = <0x1>;
				};
			};

			cam3@2 {
				phandle = <0x39>;

				pins_cmd_dat {
					output-low;
					pinmux = <0xa000>;
					slew-rate = <0x1>;
				};
			};

			cam3@3 {
				phandle = <0x3a>;

				pins_cmd_dat {
					output-high;
					pinmux = <0xa000>;
					slew-rate = <0x1>;
				};
			};

			camaf@0 {
				phandle = <0x3b>;

				pins_cmd_dat {
					output-low;
					pinmux = <0xa700>;
					slew-rate = <0x1>;
				};
			};

			camaf@1 {
				phandle = <0x3c>;

				pins_cmd_dat {
					output-high;
					pinmux = <0xa700>;
					slew-rate = <0x1>;
				};
			};

			camdefault {
				phandle = <0x1a>;
			};

			camera_pins_cam0_mclk_off {
				phandle = <0x30>;

				pins_cmd_dat {
					pinmux = <0x6300>;
				};
			};

			camera_pins_cam0_mclk_on {
				phandle = <0x2f>;

				pins_cmd_dat {
					pinmux = <0x6301>;
				};
			};

			camera_pins_cam1_mclk_off {
				phandle = <0x32>;

				pins_cmd_dat {
					pinmux = <0x6400>;
				};
			};

			camera_pins_cam1_mclk_on {
				phandle = <0x31>;

				pins_cmd_dat {
					pinmux = <0x6401>;
				};
			};

			camera_pins_cam2_mclk_off {
				phandle = <0x34>;

				pins_cmd_dat {
					pinmux = <0x6c00>;
				};
			};

			camera_pins_cam2_mclk_on {
				phandle = <0x33>;

				pins_cmd_dat {
					pinmux = <0x6c01>;
				};
			};

			camera_pins_cam3_mclk_off {
				phandle = <0x36>;

				pins_cmd_dat {
					pinmux = <0x5800>;
				};
			};

			camera_pins_cam3_mclk_on {
				phandle = <0x35>;

				pins_cmd_dat {
					pinmux = <0x5801>;
				};
			};
		};
	};

	fragment@25 {
		target = <0xffffffff>;

		__overlay__ {
			cam0_vcama-supply = <0xffffffff>;
			cam0_vcamd-supply = <0xffffffff>;
			cam0_vcamio-supply = <0xffffffff>;
			cam1_vcama-supply = <0xffffffff>;
			cam1_vcamd-supply = <0xffffffff>;
			cam1_vcamio-supply = <0xffffffff>;
			cam2_vcama-supply = <0xffffffff>;
			cam2_vcamd-supply = <0xffffffff>;
			cam2_vcamio-supply = <0xffffffff>;
			cam3_vcama-supply = <0xffffffff>;
			cam3_vcamd-supply = <0xffffffff>;
			cam3_vcamio-supply = <0xffffffff>;
			pinctrl-0 = <0x1a>;
			pinctrl-1 = <0x1b>;
			pinctrl-10 = <0x24>;
			pinctrl-11 = <0x25>;
			pinctrl-12 = <0x26>;
			pinctrl-13 = <0x27>;
			pinctrl-14 = <0x28>;
			pinctrl-15 = <0x29>;
			pinctrl-16 = <0x2a>;
			pinctrl-17 = <0x2b>;
			pinctrl-18 = <0x2c>;
			pinctrl-19 = <0x2d>;
			pinctrl-2 = <0x1c>;
			pinctrl-20 = <0x2e>;
			pinctrl-21 = <0x2f>;
			pinctrl-22 = <0x30>;
			pinctrl-23 = <0x31>;
			pinctrl-24 = <0x32>;
			pinctrl-25 = <0x33>;
			pinctrl-26 = <0x34>;
			pinctrl-27 = <0x35>;
			pinctrl-28 = <0x36>;
			pinctrl-29 = <0x37>;
			pinctrl-3 = <0x1d>;
			pinctrl-30 = <0x38>;
			pinctrl-31 = <0x39>;
			pinctrl-32 = <0x3a>;
			pinctrl-33 = <0x3b>;
			pinctrl-34 = <0x3c>;
			pinctrl-4 = <0x1e>;
			pinctrl-5 = <0x1f>;
			pinctrl-6 = <0x20>;
			pinctrl-7 = <0x21>;
			pinctrl-8 = <0x22>;
			pinctrl-9 = <0x23>;
			pinctrl-names = "default", "cam0_rst0", "cam0_rst1", "cam0_pnd0", "cam0_pnd1", "cam1_rst0", "cam1_rst1", "cam1_pnd0", "cam1_pnd1", "cam2_rst0", "cam2_rst1", "cam2_pnd0", "cam2_pnd1", "cam0_vcamd_on", "cam0_vcamd_off", "cam1_vcamd_on", "cam1_vcamd_off", "cam1_vcama_on", "cam1_vcama_off", "cam2_vcama_on", "cam2_vcama_off", "cam0_mclk_on", "cam0_mclk_off", "cam1_mclk_on", "cam1_mclk_off", "cam2_mclk_on", "cam2_mclk_off", "cam3_mclk_on", "cam3_mclk_off", "cam3_rst0", "cam3_rst1", "cam3_pnd0", "cam3_pnd1", "cam_af0", "cam_af1";
			status = "okay";
		};
	};

	fragment@26 {
		target = <0xffffffff>;

		__overlay__ {
			decouple = <0x1>;

			channel@1 {
				ct = <0x0>;
				part = <0x0>;
				type = <0x0>;
			};
		};
	};

	fragment@27 {
		target = <0xffffffff>;

		__overlay__ {

			aw87359@59 {
				compatible = "awinic,aw87359_pa";
				reg = <0x59>;
				status = "okay";
			};
		};
	};

	fragment@28 {
		target = <0xffffffff>;

		__overlay__ {

			aw87359@59 {
				compatible = "awinic,aw87359_pa_1";
				reg = <0x59>;
				status = "okay";
			};
		};
	};

	fragment@29 {
		target = <0xffffffff>;

		__overlay__ {
			cd-gpios = <0xffffffff 0x2e 0x0>;
			cd_level = [01];
		};
	};

	fragment@3 {
		target = <0xffffffff>;

		__overlay__ {

			ext_buck_vgpu@55 {
				regulator-max-microvolt = <0x13d620>;
				regulator-min-microvolt = <0x493e0>;
				regulator-name = "ext_buck_vgpu";
				vsel_pin = <0x2>;
			};
		};
	};

	fragment@30 {
		target = <0xffffffff>;

		__overlay__ {
			gpio-irq = <0xa>;
			gpio-irq-std = <0xffffffff 0xa 0x0>;
			gpio-rst = <0xac>;
			gpio-rst-std = <0xffffffff 0xac 0x0>;
		};
	};

	fragment@31 {
		target = <0xffffffff>;

		__overlay__ {

			pins_cfg {
				phandle = <0x3e>;

				pins_cmd_dat {
					bias-pull-up = <0x66>;
					pinmux = <0x300>;
					slew-rate = <0x0>;
				};
			};

			pins_default {
				phandle = <0x3d>;
			};
		};
	};

	fragment@32 {
		target = <0xffffffff>;

		__overlay__ {
			debounce = <0x9 0xfa00>;
			pinctrl-0 = <0x3d>;
			pinctrl-1 = <0x3e>;
			pinctrl-names = "default", "state_eint_as_int";
			reportkey_eint_pin = <0xffffffff 0x3 0x0>;
			status = "okay";
		};
	};

	fragment@33 {
		target = <0xffffffff>;

		__overlay__ {
			#address-cells = <0x1>;
			#size-cells = <0x0>;

			fingerprint@0 {
				compatible = "goodix,goodix-fp";
				fingerprint,touch-int-gpio = <0xffffffff 0x7 0x0>;
				netlink-event = <0x1e>;
				reg = <0x0>;
				spi-max-frequency = <0x5b8d80>;
				status = "okay";
			};
		};
	};

	fragment@34 {
		target = <0xffffffff>;

		__overlay__ {
			pinctrl-0 = <0x3f>;
			pinctrl-1 = <0x40>;
			pinctrl-2 = <0x41>;
			pinctrl-3 = <0x42>;
			pinctrl-4 = <0x43>;
			pinctrl-5 = <0x44>;
			pinctrl-6 = <0x45>;
			pinctrl-7 = <0x46>;
			pinctrl-names = "default", "state_spi_rst_high", "state_spi_rst_low", "state_spi_eint_init", "state_spi_miso_init", "state_spi_mosi_init", "state_spi_cs_init", "state_spi_ck_init";
			status = "okay";
			vfingerprint-supply = <0xffffffff>;
		};
	};

	fragment@35 {
		target = <0xffffffff>;

		__overlay__ {

			state_default {
				phandle = <0x3f>;
			};

			state_spi_ck_init {
				phandle = <0x46>;

				pins_cmd_dat {
					bias-pull-up = <0x0>;
					pinmux = <0x9e01>;
					slew-rate = <0x1>;
				};
			};

			state_spi_cs_init {
				phandle = <0x45>;

				pins_cmd_dat {
					bias-pull-up = <0x0>;
					pinmux = <0x9c01>;
					slew-rate = <0x1>;
				};
			};

			state_spi_eint_init {
				phandle = <0x42>;

				pins_cmd_dat {
					bias-pull-up = <0x0>;
					pinmux = <0x700>;
					slew-rate = <0x0>;
				};
			};

			state_spi_miso_init {
				phandle = <0x43>;

				pins_cmd_dat {
					bias-pull-up = <0x0>;
					pinmux = <0x9b01>;
					slew-rate = <0x0>;
				};
			};

			state_spi_mosi_init {
				phandle = <0x44>;

				pins_cmd_dat {
					bias-pull-up = <0x0>;
					pinmux = <0x9d01>;
					slew-rate = <0x1>;
				};
			};

			state_spi_rst_high {
				phandle = <0x40>;

				pins_cmd_dat {
					output-high;
					pinmux = <0x800>;
					slew-rate = <0x1>;
				};
			};

			state_spi_rst_low {
				phandle = <0x41>;

				pins_cmd_dat {
					output-low;
					pinmux = <0x800>;
					slew-rate = <0x1>;
				};
			};
		};
	};

	fragment@36 {
		target = <0xffffffff>;

		__overlay__ {
			battery0_profile_t0 = <0x0 0xab64 0x15b 0x333 0xaad1 0x15b 0x665 0xaa4f 0x15e 0x998 0xa9d0 0x15e 0xccb 0xa952 0x15c 0xffe 0xa8d5 0x159 0x1330 0xa859 0x15b 0x1663 0xa7dc 0x15b 0x1996 0xa75f 0x163 0x1cc9 0xa6e2 0x163 0x1ffb 0xa664 0x15e 0x232e 0xa5e6 0x15e 0x2661 0xa56b 0x15e 0x2994 0xa4f0 0x163 0x2cc6 0xa476 0x16b 0x2ff9 0xa3fb 0x168 0x332c 0xa382 0x168 0x365f 0xa308 0x166 0x3991 0xa291 0x16b 0x3cc4 0xa21a 0x16d 0x3ff7 0xa1a4 0x16f 0x432a 0xa130 0x172 0x465c 0xa0bd 0x177 0x498f 0xa04a 0x174 0x4cc2 0x9fda 0x179 0x4ff5 0x9f6b 0x17c 0x5327 0x9efe 0x181 0x565a 0x9e92 0x181 0x598d 0x9e28 0x184 0x5cbf 0x9dc0 0x18b 0x5ff2 0x9d5a 0x190 0x6325 0x9cf4 0x195 0x6658 0x9c90 0x198 0x698a 0x9c2e 0x19a 0x6cbd 0x9bcd 0x19f 0x6ff0 0x9b6b 0x1a4 0x7323 0x9b06 0x1a7 0x7655 0x9a9f 0x1ae 0x7988 0x9a32 0x1ab 0x7cbb 0x99c4 0x1a7 0x7fee 0x9956 0x19a 0x8320 0x98e7 0x18e 0x8653 0x987a 0x181 0x8986 0x9815 0x175 0x8cb9 0x97bd 0x16f 0x8feb 0x976d 0x16d 0x931e 0x9726 0x16d 0x9651 0x96e2 0x168 0x9984 0x96a3 0x16b 0x9cb6 0x9667 0x16b 0x9fe9 0x962d 0x168 0xa31c 0x95f7 0x16b 0xa64e 0x95c3 0x16d 0xa981 0x9591 0x172 0xacb4 0x9561 0x175 0xafe7 0x9532 0x172 0xb319 0x9506 0x175 0xb64c 0x94db 0x179 0xb97f 0x94b2 0x17c 0xbcb2 0x948b 0x181 0xbfe4 0x9466 0x186 0xc317 0x9440 0x186 0xc64a 0x941c 0x188 0xc97d 0x93f7 0x18e 0xccaf 0x93d0 0x18e 0xcfe2 0x93a2 0x18b 0xd315 0x936c 0x188 0xd648 0x9329 0x17c 0xd97a 0x92e4 0x172 0xdcad 0x92ab 0x174 0xdfe0 0x9279 0x177 0xe313 0x9247 0x174 0xe645 0x9214 0x175 0xe978 0x91e5 0x172 0xecab 0x91ba 0x16f 0xefde 0x9193 0x177 0xf310 0x9167 0x17a 0xf643 0x9134 0x17e 0xf976 0x90f7 0x17c 0xfca8 0x90b7 0x179 0xffdb 0x907c 0x184 0x1030e 0x9037 0x186 0x10641 0x8fe5 0x174 0x10973 0x8fbc 0x172 0x10ca6 0x8faf 0x17a 0x10fd9 0x8fa2 0x188 0x1130c 0x8f90 0x19d 0x1163e 0x8f73 0x1b3 0x11971 0x8f34 0x1cf 0x11ca4 0x8e93 0x1d9 0x11fd7 0x8d0f 0x1a9 0x12309 0x8af2 0x1b1 0x1263c 0x8817 0x1c4 0x1296f 0x83e8 0x1f9 0x12ca2 0x7bad 0x352>;
			battery0_profile_t0_col = <0x3>;
			battery0_profile_t0_num = <0x5f>;
			battery0_profile_t1 = <0x0 0xab64 0x1bf 0x333 0xaad1 0x1bf 0x665 0xaa4f 0x1c0 0x998 0xa9d0 0x1c2 0xccb 0xa952 0x1c2 0xffe 0xa8d5 0x1c7 0x1330 0xa859 0x1c2 0x1663 0xa7dc 0x1c7 0x1996 0xa75f 0x1ca 0x1cc9 0xa6e2 0x1c2 0x1ffb 0xa664 0x1c2 0x232e 0xa5e6 0x1c2 0x2661 0xa56b 0x1c5 0x2994 0xa4f0 0x1c5 0x2cc6 0xa476 0x1c4 0x2ff9 0xa3fb 0x1bd 0x332c 0xa382 0x1c2 0x365f 0xa308 0x1c4 0x3991 0xa291 0x1c5 0x3cc4 0xa21a 0x1cc 0x3ff7 0xa1a4 0x1d1 0x432a 0xa130 0x1d3 0x465c 0xa0bd 0x1d4 0x498f 0xa04a 0x1d9 0x4cc2 0x9fda 0x1db 0x4ff5 0x9f6b 0x1e2 0x5327 0x9efe 0x1de 0x565a 0x9e92 0x1e8 0x598d 0x9e28 0x201 0x5cbf 0x9dc0 0x1fc 0x5ff2 0x9d5a 0x1f2 0x6325 0x9cf4 0x1e5 0x6658 0x9c90 0x1e8 0x698a 0x9c2e 0x1f1 0x6cbd 0x9bcd 0x201 0x6ff0 0x9b6b 0x212 0x7323 0x9b06 0x20b 0x7655 0x9a9f 0x205 0x7988 0x9a32 0x1f4 0x7cbb 0x99c4 0x1e8 0x7fee 0x9956 0x1db 0x8320 0x98e7 0x1c2 0x8653 0x987a 0x1b8 0x8986 0x9815 0x1ab 0x8cb9 0x97bd 0x19f 0x8feb 0x976d 0x192 0x931e 0x9726 0x192 0x9651 0x96e2 0x184 0x9984 0x96a3 0x184 0x9cb6 0x9667 0x181 0x9fe9 0x962d 0x181 0xa31c 0x95f7 0x184 0xa64e 0x95c3 0x189 0xa981 0x9591 0x186 0xacb4 0x9561 0x184 0xafe7 0x9532 0x18b 0xb319 0x9506 0x190 0xb64c 0x94db 0x192 0xb97f 0x94b2 0x197 0xbcb2 0x948b 0x197 0xbfe4 0x9466 0x19f 0xc317 0x9440 0x19a 0xc64a 0x941c 0x1a1 0xc97d 0x93f7 0x1a1 0xccaf 0x93d0 0x19f 0xcfe2 0x93a2 0x19d 0xd315 0x936c 0x1a2 0xd648 0x9329 0x19d 0xd97a 0x92e4 0x198 0xdcad 0x92ab 0x198 0xdfe0 0x9279 0x18e 0xe313 0x9247 0x189 0xe645 0x9214 0x181 0xe978 0x91e5 0x184 0xecab 0x91ba 0x186 0xefde 0x9193 0x189 0xf310 0x9167 0x18e 0xf643 0x9134 0x193 0xf976 0x90f7 0x19a 0xfca8 0x90b7 0x19a 0xffdb 0x907c 0x19f 0x1030e 0x9037 0x1a4 0x10641 0x8fe5 0x1b1 0x10973 0x8fbc 0x1b0 0x10ca6 0x8faf 0x1ae 0x10fd9 0x8fa2 0x1bb 0x1130c 0x8f90 0x1c2 0x1163e 0x8f73 0x1d6 0x11971 0x8f34 0x1ea 0x11ca4 0x8e93 0x201 0x11fd7 0x8d0f 0x20d 0x12309 0x8af2 0x203 0x1263c 0x8817 0x21e 0x1296f 0x83e8 0x23f 0x12ca2 0x7bad 0x283>;
			battery0_profile_t1_col = <0x3>;
			battery0_profile_t1_num = <0x5f>;
			battery0_profile_t2 = <0x0 0xabd5 0x774 0x333 0xab05 0x774 0x665 0xaa68 0x771 0x998 0xa9db 0x760 0xccb 0xa953 0x750 0xffe 0xa8d0 0x742 0x1330 0xa84f 0x730 0x1663 0xa7cf 0x71c 0x1996 0xa753 0x715 0x1cc9 0xa6d7 0x6fc 0x1ffb 0xa65d 0x6f4 0x232e 0xa5e3 0x6e5 0x2661 0xa569 0x6d9 0x2994 0xa4f0 0x6ca 0x2cc6 0xa478 0x6c2 0x2ff9 0xa401 0x6b8 0x332c 0xa38c 0x6ae 0x365f 0xa319 0x6ac 0x3991 0xa2a5 0x6a7 0x3cc4 0xa231 0x6a2 0x3ff7 0xa1be 0x69d 0x432a 0xa14b 0x69a 0x465c 0xa0d6 0x695 0x498f 0xa064 0x693 0x4cc2 0x9ff3 0x690 0x4ff5 0x9f8b 0x68e 0x5327 0x9f32 0x698 0x565a 0x9ede 0x6ac 0x598d 0x9e76 0x6c0 0x5cbf 0x9df0 0x6b8 0x5ff2 0x9d4a 0x69a 0x6325 0x9c9f 0x67c 0x6658 0x9c05 0x668 0x698a 0x9b83 0x659 0x6cbd 0x9b15 0x64d 0x6ff0 0x9ab9 0x64d 0x7323 0x9a65 0x64a 0x7655 0x9a0f 0x643 0x7988 0x99b8 0x634 0x7cbb 0x995d 0x61b 0x7fee 0x9901 0x607 0x8320 0x98a6 0x5f5 0x8653 0x984e 0x5e4 0x8986 0x97fa 0x5d5 0x8cb9 0x97ab 0x5d0 0x8feb 0x9760 0x5c6 0x931e 0x9719 0x5c3 0x9651 0x96d6 0x5be 0x9984 0x9697 0x5bc 0x9cb6 0x965b 0x5c1 0x9fe9 0x9622 0x5be 0xa31c 0x95ec 0x5c3 0xa64e 0x95b8 0x5c6 0xa981 0x9585 0x5c8 0xacb4 0x9556 0x5cd 0xafe7 0x9528 0x5cd 0xb319 0x94fd 0x5d2 0xb64c 0x94d3 0x5d5 0xb97f 0x94ab 0x5dc 0xbcb2 0x9485 0x5df 0xbfe4 0x9460 0x5df 0xc317 0x943d 0x5e6 0xc64a 0x941c 0x5e6 0xc97d 0x93fd 0x5e9 0xccaf 0x93e1 0x5ee 0xcfe2 0x93c8 0x5f2 0xd315 0x93b2 0x5f8 0xd648 0x939c 0x602 0xd97a 0x9386 0x607 0xdcad 0x936f 0x60e 0xdfe0 0x9357 0x618 0xe313 0x933b 0x622 0xe645 0x931c 0x62a 0xe978 0x92fa 0x636 0xecab 0x92d5 0x645 0xefde 0x92af 0x652 0xf310 0x9285 0x663 0xf643 0x9255 0x677 0xf976 0x921d 0x68e 0xfca8 0x91de 0x6ab 0xffdb 0x919b 0x6c2 0x1030e 0x9159 0x6e5 0x10641 0x910f 0x708 0x10973 0x90b8 0x72e 0x10ca6 0x9070 0x756 0x10fd9 0x9043 0x78c 0x1130c 0x9024 0x7d0 0x1163e 0x9006 0x816 0x11971 0x8fe1 0x870 0x11ca4 0x8fa8 0x8dc 0x11fd7 0x8f26 0x951 0x12309 0x8e14 0x9b8 0x1263c 0x8c48 0xa23 0x1296f 0x89ba 0xadf 0x12ca2 0x8618 0xc06>;
			battery0_profile_t2_col = <0x3>;
			battery0_profile_t2_num = <0x5f>;
			battery0_profile_t3 = <0x0 0xabd3 0xa41 0x333 0xab02 0xa41 0x665 0xaa5a 0xa35 0x998 0xa9c0 0xa12 0xccb 0xa92d 0x9ef 0xffe 0xa8a1 0x9c6 0x1330 0xa819 0x99f 0x1663 0xa796 0x97b 0x1996 0xa717 0x95b 0x1cc9 0xa697 0x936 0x1ffb 0xa61b 0x913 0x232e 0xa59f 0x8f2 0x2661 0xa525 0x8d7 0x2994 0xa4aa 0x8b8 0x2cc6 0xa434 0x8a2 0x2ff9 0xa3c0 0x88c 0x332c 0xa34d 0x882 0x365f 0xa2da 0x870 0x3991 0xa267 0x869 0x3cc4 0xa1f4 0x855 0x3ff7 0xa183 0x850 0x432a 0xa110 0x841 0x465c 0xa09f 0x82f 0x498f 0xa033 0x823 0x4cc2 0x9fd3 0x825 0x4ff5 0x9f7d 0x843 0x5327 0x9f24 0x86b 0x565a 0x9eb8 0x884 0x598d 0x9e30 0x86d 0x5cbf 0x9d8c 0x82d 0x5ff2 0x9cdf 0x7df 0x6325 0x9c3f 0x7a3 0x6658 0x9bb1 0x771 0x698a 0x9b38 0x756 0x6cbd 0x9ad0 0x744 0x6ff0 0x9a75 0x73f 0x7323 0x9a20 0x738 0x7655 0x99cb 0x72b 0x7988 0x9973 0x710 0x7cbb 0x9919 0x6ed 0x7fee 0x98c1 0x6cc 0x8320 0x9868 0x6a9 0x8653 0x9814 0x692 0x8986 0x97c3 0x681 0x8cb9 0x9777 0x670 0x8feb 0x9730 0x668 0x931e 0x96eb 0x666 0x9651 0x96aa 0x661 0x9984 0x966c 0x659 0x9cb6 0x9632 0x65c 0x9fe9 0x95fb 0x663 0xa31c 0x95c6 0x668 0xa64e 0x9593 0x66b 0xa981 0x9564 0x672 0xacb4 0x9535 0x675 0xafe7 0x950a 0x67f 0xb319 0x94e0 0x686 0xb64c 0x94b8 0x68e 0xb97f 0x9493 0x69a 0xbcb2 0x946e 0x69d 0xbfe4 0x944d 0x6a4 0xc317 0x942e 0x6ac 0xc64a 0x9413 0x6b6 0xc97d 0x93fb 0x6c5 0xccaf 0x93e8 0x6d9 0xcfe2 0x93d4 0x6ef 0xd315 0x93c1 0x70d 0xd648 0x93ae 0x728 0xd97a 0x939a 0x73d 0xdcad 0x9383 0x75d 0xdfe0 0x936b 0x783 0xe313 0x934f 0x79e 0xe645 0x9331 0x7c6 0xe978 0x930f 0x7ee 0xecab 0x92ea 0x820 0xefde 0x92c1 0x850 0xf310 0x9291 0x884 0xf643 0x925c 0x8c5 0xf976 0x921f 0x903 0xfca8 0x91e1 0x959 0xffdb 0x919f 0x9ae 0x1030e 0x9155 0xa12 0x10641 0x9105 0xa7b 0x10973 0x90bb 0xaf0 0x10ca6 0x9082 0xb75 0x10fd9 0x9057 0xc06 0x1130c 0x9034 0xcb9 0x1163e 0x9012 0xd87 0x11971 0x8fe2 0xe6d 0x11ca4 0x8f82 0xf62 0x11fd7 0x8eb7 0x104a 0x12309 0x8d59 0x1130 0x1263c 0x8b58 0x1261 0x1296f 0x8889 0x1432 0x12ca2 0x8458 0x16d3>;
			battery0_profile_t3_col = <0x3>;
			battery0_profile_t3_num = <0x5f>;
			battery0_profile_t4 = <0x0 0xabed 0x1aef 0x333 0xaaca 0x1aef 0x665 0xa9dc 0x1adb 0x998 0xa90b 0x1a8b 0xccb 0xa84e 0x1a1b 0xffe 0xa79e 0x19a0 0x1330 0xa6f6 0x1950 0x1663 0xa655 0x18ea 0x1996 0xa5bc 0x1874 0x1cc9 0xa529 0x181d 0x1ffb 0xa49c 0x17e6 0x232e 0xa413 0x178e 0x2661 0xa38c 0x1741 0x2994 0xa307 0x170f 0x2cc6 0xa284 0x16d0 0x2ff9 0xa203 0x1688 0x332c 0xa189 0x164c 0x365f 0xa11b 0x1642 0x3991 0xa0b4 0x1633 0x3cc4 0xa048 0x1628 0x3ff7 0x9fcd 0x160b 0x432a 0x9f3f 0x15bb 0x465c 0x9e9c 0x153e 0x498f 0x9df6 0x14b9 0x4cc2 0x9d58 0x1426 0x4ff5 0x9cca 0x13ce 0x5327 0x9c4b 0x139c 0x565a 0x9bd8 0x1365 0x598d 0x9b70 0x1338 0x5cbf 0x9b14 0x133b 0x5ff2 0x9abb 0x133b 0x6325 0x9a66 0x1331 0x6658 0x9a0f 0x1327 0x698a 0x99b6 0x1313 0x6cbd 0x995c 0x1304 0x6ff0 0x9904 0x12f2 0x7323 0x98ac 0x12e1 0x7655 0x9858 0x12de 0x7988 0x9807 0x12dc 0x7cbb 0x97b9 0x12c5 0x7fee 0x976d 0x12b6 0x8320 0x9725 0x12ac 0x8653 0x96e2 0x12bb 0x8986 0x96a1 0x12bb 0x8cb9 0x9663 0x12be 0x8feb 0x9628 0x12d2 0x931e 0x95f1 0x12e3 0x9651 0x95bd 0x12fa 0x9984 0x958d 0x1301 0x9cb6 0x9561 0x1322 0x9fe9 0x953a 0x1344 0xa31c 0x9517 0x136a 0xa64e 0x94f7 0x139c 0xa981 0x94da 0x13ba 0xacb4 0x94bf 0x1403 0xafe7 0x94a7 0x142b 0xb319 0x948f 0x146e 0xb64c 0x9478 0x14bc 0xb97f 0x9463 0x1504 0xbcb2 0x944e 0x153b 0xbfe4 0x9439 0x158b 0xc317 0x9423 0x15ea 0xc64a 0x940e 0x1656 0xc97d 0x93f8 0x16a6 0xccaf 0x93e2 0x1705 0xcfe2 0x93cb 0x1787 0xd315 0x93b3 0x180b 0xd648 0x9399 0x186f 0xd97a 0x937e 0x18ec 0xdcad 0x9361 0x1991 0xdfe0 0x9344 0x1a3b 0xe313 0x9324 0x1aae 0xe645 0x9301 0x1b4e 0xe978 0x92dc 0x1bfd 0xecab 0x92b4 0x1cb9 0xefde 0x9287 0x1d6f 0xf310 0x9258 0x1e41 0xf643 0x9226 0x1f16 0xf976 0x91ef 0x1fe0 0xfca8 0x91b4 0x20ab 0xffdb 0x9175 0x2195 0x1030e 0x9135 0x22c2 0x10641 0x90f7 0x23da 0x10973 0x90bb 0x250d 0x10ca6 0x9083 0x2641 0x10fd9 0x904e 0x27ab 0x1130c 0x9019 0x291b 0x1163e 0x8fdc 0x2aa8 0x11971 0x8f89 0x2c3b 0x11ca4 0x8f07 0x2d80 0x11fd7 0x8e3b 0x2e98 0x12309 0x8d0d 0x2f6a 0x1263c 0x8b6a 0x2ff6 0x1296f 0x892c 0x310b 0x12ca2 0x85da 0x3372>;
			battery0_profile_t4_col = <0x3>;
			battery0_profile_t4_num = <0x5f>;
			battery0_profile_t5 = <0x0 0xabed 0x1aef 0x333 0xaaca 0x1aef 0x665 0xa9dc 0x1adb 0x998 0xa90b 0x1a8b 0xccb 0xa84e 0x1a1b 0xffe 0xa79e 0x19a0 0x1330 0xa6f6 0x1950 0x1663 0xa655 0x18ea 0x1996 0xa5bc 0x1874 0x1cc9 0xa529 0x181d 0x1ffb 0xa49c 0x17e6 0x232e 0xa413 0x178e 0x2661 0xa38c 0x1741 0x2994 0xa307 0x170f 0x2cc6 0xa284 0x16d0 0x2ff9 0xa203 0x1688 0x332c 0xa189 0x164c 0x365f 0xa11b 0x1642 0x3991 0xa0b4 0x1633 0x3cc4 0xa048 0x1628 0x3ff7 0x9fcd 0x160b 0x432a 0x9f3f 0x15bb 0x465c 0x9e9c 0x153e 0x498f 0x9df6 0x14b9 0x4cc2 0x9d58 0x1426 0x4ff5 0x9cca 0x13ce 0x5327 0x9c4b 0x139c 0x565a 0x9bd8 0x1365 0x598d 0x9b70 0x1338 0x5cbf 0x9b14 0x133b 0x5ff2 0x9abb 0x133b 0x6325 0x9a66 0x1331 0x6658 0x9a0f 0x1327 0x698a 0x99b6 0x1313 0x6cbd 0x995c 0x1304 0x6ff0 0x9904 0x12f2 0x7323 0x98ac 0x12e1 0x7655 0x9858 0x12de 0x7988 0x9807 0x12dc 0x7cbb 0x97b9 0x12c5 0x7fee 0x976d 0x12b6 0x8320 0x9725 0x12ac 0x8653 0x96e2 0x12bb 0x8986 0x96a1 0x12bb 0x8cb9 0x9663 0x12be 0x8feb 0x9628 0x12d2 0x931e 0x95f1 0x12e3 0x9651 0x95bd 0x12fa 0x9984 0x958d 0x1301 0x9cb6 0x9561 0x1322 0x9fe9 0x953a 0x1344 0xa31c 0x9517 0x136a 0xa64e 0x94f7 0x139c 0xa981 0x94da 0x13ba 0xacb4 0x94bf 0x1403 0xafe7 0x94a7 0x142b 0xb319 0x948f 0x146e 0xb64c 0x9478 0x14bc 0xb97f 0x9463 0x1504 0xbcb2 0x944e 0x153b 0xbfe4 0x9439 0x158b 0xc317 0x9423 0x15ea 0xc64a 0x940e 0x1656 0xc97d 0x93f8 0x16a6 0xccaf 0x93e2 0x1705 0xcfe2 0x93cb 0x1787 0xd315 0x93b3 0x180b 0xd648 0x9399 0x186f 0xd97a 0x937e 0x18ec 0xdcad 0x9361 0x1991 0xdfe0 0x9344 0x1a3b 0xe313 0x9324 0x1aae 0xe645 0x9301 0x1b4e 0xe978 0x92dc 0x1bfd 0xecab 0x92b4 0x1cb9 0xefde 0x9287 0x1d6f 0xf310 0x9258 0x1e41 0xf643 0x9226 0x1f16 0xf976 0x91ef 0x1fe0 0xfca8 0x91b4 0x20ab 0xffdb 0x9175 0x2195 0x1030e 0x9135 0x22c2 0x10641 0x90f7 0x23da 0x10973 0x90bb 0x250d 0x10ca6 0x9083 0x2641 0x10fd9 0x904e 0x27ab 0x1130c 0x9019 0x291b 0x1163e 0x8fdc 0x2aa8 0x11971 0x8f89 0x2c3b 0x11ca4 0x8f07 0x2d80 0x11fd7 0x8e3b 0x2e98 0x12309 0x8d0d 0x2f6a 0x1263c 0x8b6a 0x2ff6 0x1296f 0x892c 0x310b 0x12ca2 0x85da 0x3372>;
			battery0_profile_t5_col = <0x3>;
			battery0_profile_t5_num = <0x5f>;
		};
	};

	fragment@37 {
		target = <0xffffffff>;

		__overlay__ {

			adc_channel@ {
				compatible = "mediatek,adc_channel";
				mediatek,adc_fdd_rf_params_dynamic_custom_ch = <0x2>;
				mediatek,temperature0 = <0x0>;
				mediatek,temperature1 = <0x1>;
				status = "okay";
			};
		};
	};

	fragment@38 {
		target = <0xffffffff>;

		__overlay__ {
			io-channels = <0xffffffff 0x2>;
		};
	};

	fragment@39 {
		target = <0xffffffff>;

		__overlay__ {
			mediatek,clkbuf-config = <0x2 0x1 0x1 0x2 0x0 0x0 0x0>;
			mediatek,clkbuf-driving-current = <0x1 0x1 0x1 0x1 0x1 0x1 0x1>;
			mediatek,clkbuf-quantity = <0x7>;
			status = "okay";
		};
	};

	fragment@4 {
		target = <0xffffffff>;

		__overlay__ {

			consys_default {
				phandle = <0x1>;
			};

			gpslna@0 {
				phandle = <0x2>;

				pins_cmd_dat {
					bias-disable;
					output-low;
					pinmux = <0x4e00>;
					slew-rate = <0x0>;
				};
			};

			gpslna@1 {
				phandle = <0x3>;

				pins_cmd_dat {
					output-high;
					pinmux = <0x4e00>;
					slew-rate = <0x1>;
				};
			};

			gpslna@2 {
				phandle = <0x4>;

				pins_cmd_dat {
					output-low;
					pinmux = <0x4e00>;
					slew-rate = <0x1>;
				};
			};
		};
	};

	fragment@40 {
		target = <0xffffffff>;

		__overlay__ {
			#address-cells = <0x1>;
			#size-cells = <0x0>;
			clock-frequency = <0x61a80>;
			mediatek,use-open-drain;

			cap_touch@5d {
				compatible = "mediatek,cap_touch";
				phandle = <0x50>;
				reg = <0x5d>;
				status = "okay";
			};
		};
	};

	fragment@41 {
		target = <0xffffffff>;

		__overlay__ {
			#address-cells = <0x1>;
			#size-cells = <0x0>;
			clock-frequency = <0x61a80>;
			mediatek,use-open-drain;
		};
	};

	fragment@42 {
		target = <0xffffffff>;

		__overlay__ {
			#address-cells = <0x1>;
			#size-cells = <0x0>;
			clock-frequency = <0x61a80>;
			mediatek,use-open-drain;

			camera_main@1a {
				compatible = "mediatek,camera_main";
				phandle = <0x51>;
				reg = <0x1a>;
				status = "okay";
			};

			camera_main_af@0c {
				compatible = "mediatek,camera_main_af";
				phandle = <0x53>;
				reg = <0xc>;
				status = "okay";
			};

			camera_main_eeprom@50 {
				compatible = "mediatek,camera_main_eeprom";
				phandle = <0x52>;
				reg = <0x50>;
				status = "okay";
			};

			camera_main_two@2d {
				compatible = "mediatek,camera_main_two";
				phandle = <0x54>;
				reg = <0x2d>;
				status = "okay";
			};

			camera_main_two_af@1c {
				compatible = "mediatek,camera_main_two_af";
				phandle = <0x56>;
				reg = <0x1c>;
				status = "okay";
			};

			camera_main_two_eeprom@60 {
				compatible = "mediatek,camera_main_two_eeprom";
				phandle = <0x55>;
				reg = <0x60>;
				status = "okay";
			};

			ccu_sensor_i2c_2_hw@10 {
				compatible = "mediatek,ccu_sensor_i2c_2_hw";
				phandle = <0x57>;
				reg = <0x10>;
				status = "okay";
			};
		};
	};

	fragment@43 {
		target = <0xffffffff>;

		__overlay__ {
			#address-cells = <0x1>;
			#size-cells = <0x0>;
			clock-frequency = <0x61a80>;
			mediatek,use-open-drain;

			ext_buck_lp4@57 {
				compatible = "mediatek,ext_buck_lp4";
				phandle = <0x5b>;
				reg = <0x57>;
				status = "okay";
			};

			ext_buck_lp4x@50 {
				compatible = "mediatek,ext_buck_lp4x";
				phandle = <0x5c>;
				reg = <0x50>;
				status = "okay";
			};

			nfc@08 {
				compatible = "mediatek,nfc";
				phandle = <0x5a>;
				reg = <0x8>;
				status = "okay";
			};

			slave_charger@4b {
				compatible = "mediatek,slave_charger";
				phandle = <0x59>;
				reg = <0x4b>;
				status = "okay";
			};

			speaker_amp@34 {
				compatible = "mediatek,speaker_amp";
				phandle = <0x58>;
				reg = <0x34>;
				status = "okay";
			};
		};
	};

	fragment@44 {
		target = <0xffffffff>;

		__overlay__ {
			#address-cells = <0x1>;
			#size-cells = <0x0>;
			clock-frequency = <0x61a80>;
			mediatek,use-open-drain;

			camera_sub@2d {
				compatible = "mediatek,camera_sub";
				phandle = <0x5d>;
				reg = <0x2d>;
				status = "okay";
			};

			camera_sub_eeprom@52 {
				compatible = "mediatek,camera_sub_eeprom";
				phandle = <0x5e>;
				reg = <0x52>;
				status = "okay";
			};

			camera_sub_two@22 {
				compatible = "mediatek,camera_sub_two";
				phandle = <0x60>;
				reg = <0x22>;
				status = "okay";
			};

			ccu_sensor_i2c_4_hw@11 {
				compatible = "mediatek,ccu_sensor_i2c_4_hw";
				phandle = <0x5f>;
				reg = <0x11>;
				status = "okay";
			};
		};
	};

	fragment@45 {
		target = <0xffffffff>;

		__overlay__ {
			#address-cells = <0x1>;
			#size-cells = <0x0>;
			clock-frequency = <0x33e140>;
			mediatek,use-push-pull;

			subpmic_pmu@34 {
				compatible = "mediatek,subpmic_pmu";
				phandle = <0x61>;
				reg = <0x34>;
				status = "okay";
			};

			usb_type_c@4e {
				compatible = "mediatek,usb_type_c";
				phandle = <0x62>;
				reg = <0x4e>;
				status = "okay";
			};
		};
	};

	fragment@46 {
		target = <0xffffffff>;

		__overlay__ {
			#address-cells = <0x1>;
			#size-cells = <0x0>;
			clock-frequency = <0x61a80>;
			mediatek,use-open-drain;

			ext_buck_vgpu@55 {
				compatible = "mediatek,ext_buck_vgpu";
				phandle = <0x63>;
				reg = <0x55>;
				status = "okay";
			};
		};
	};

	fragment@47 {
		target = <0xffffffff>;

		__overlay__ {
			#address-cells = <0x1>;
			#size-cells = <0x0>;
			clock-frequency = <0x61a80>;
			mediatek,use-open-drain;
		};
	};

	fragment@48 {
		target = <0xffffffff>;

		__overlay__ {
			#address-cells = <0x1>;
			#size-cells = <0x0>;
			clock-frequency = <0x61a80>;
			mediatek,use-open-drain;
		};
	};

	fragment@49 {
		target = <0xffffffff>;

		__overlay__ {
			#address-cells = <0x1>;
			#size-cells = <0x0>;
			clock-frequency = <0x61a80>;
			mediatek,use-open-drain;
		};
	};

	fragment@5 {
		target = <0xffffffff>;

		__overlay__ {
			pinctrl-0 = <0x1>;
			pinctrl-1 = <0x2>;
			pinctrl-2 = <0x3>;
			pinctrl-3 = <0x4>;
			pinctrl-names = "default", "gps_lna_state_init", "gps_lna_state_oh", "gps_lna_state_ol";
			status = "okay";
		};
	};

	fragment@50 {
		target = <0xffffffff>;

		__overlay__ {
			GPIO_FDD_BAND_SUPPORT_DETECT_1ST_PIN = <0xffffffff 0x48 0x0>;
			GPIO_FDD_BAND_SUPPORT_DETECT_2ND_PIN = <0xffffffff 0x47 0x0>;
			GPIO_FDD_BAND_SUPPORT_DETECT_3RD_PIN = <0xffffffff 0x46 0x0>;
			GPIO_SIM1_HOT_PLUG = <0xffffffff 0x2f 0x0>;
			GPIO_SIM1_SCLK = <0xffffffff 0x26 0x0>;
			GPIO_SIM1_SIO = <0xffffffff 0x28 0x0>;
			GPIO_SIM1_SRST = <0xffffffff 0x27 0x0>;
			GPIO_SIM2_SCLK = <0xffffffff 0x25 0x0>;
			GPIO_SIM2_SIO = <0xffffffff 0x23 0x0>;
			GPIO_SIM2_SRST = <0xffffffff 0x24 0x0>;
		};
	};

	fragment@51 {
		target = <0xffffffff>;

		__overlay__ {
			gpio_init_default = <0x0 0x0 0x0 0x0 0x1 0x1 0x1 0x1 0x0 0x0 0x0 0x0 0x0 0x1 0x2 0x0 0x0 0x0 0x1 0x1 0x1 0x3 0x0 0x0 0x0 0x1 0x1 0x1 0x4 0x0 0x0 0x0 0x1 0x0 0x0 0x5 0x5 0x1 0x0 0x0 0x0 0x0 0x6 0x0 0x0 0x0 0x1 0x1 0x0 0x7 0x0 0x0 0x0 0x1 0x1 0x0 0x8 0x0 0x1 0x0 0x1 0x0 0x0 0x9 0x0 0x0 0x0 0x1 0x1 0x0 0xa 0x0 0x0 0x0 0x1 0x0 0x0 0xb 0x0 0x0 0x0 0x1 0x1 0x0 0xc 0x0 0x0 0x0 0x1 0x1 0x0 0xd 0x3 0x0 0x0 0x1 0x0 0x0 0xe 0x3 0x1 0x0 0x0 0x0 0x0 0xf 0x3 0x1 0x0 0x0 0x0 0x0 0x10 0x3 0x1 0x0 0x0 0x0 0x0 0x11 0x6 0x0 0x0 0x1 0x0 0x0 0x12 0x6 0x1 0x0 0x0 0x0 0x0 0x13 0x6 0x1 0x0 0x0 0x0 0x0 0x14 0x6 0x1 0x0 0x0 0x0 0x0 0x15 0x3 0x0 0x0 0x1 0x1 0x0 0x16 0x3 0x0 0x0 0x1 0x0 0x0 0x17 0x0 0x0 0x0 0x1 0x1 0x0 0x18 0x3 0x0 0x0 0x1 0x0 0x0 0x19 0x3 0x0 0x0 0x1 0x1 0x0 0x1a 0x3 0x0 0x0 0x1 0x1 0x0 0x1b 0x3 0x1 0x0 0x0 0x0 0x0 0x1c 0x3 0x0 0x0 0x1 0x1 0x0 0x1d 0x1 0x1 0x0 0x0 0x0 0x1 0x1e 0x1 0x0 0x0 0x1 0x1 0x1 0x1f 0x1 0x0 0x0 0x1 0x1 0x1 0x20 0x1 0x0 0x0 0x1 0x1 0x1 0x21 0x1 0x0 0x0 0x1 0x1 0x1 0x22 0x1 0x0 0x0 0x1 0x1 0x1 0x23 0x1 0x0 0x0 0x1 0x1 0x0 0x24 0x1 0x1 0x0 0x0 0x0 0x0 0x25 0x1 0x1 0x0 0x0 0x0 0x0 0x26 0x1 0x1 0x0 0x0 0x0 0x0 0x27 0x1 0x1 0x0 0x0 0x0 0x0 0x28 0x1 0x0 0x0 0x1 0x1 0x0 0x29 0x0 0x0 0x0 0x1 0x1 0x0 0x2a 0x0 0x0 0x0 0x1 0x0 0x0 0x2b 0x1 0x1 0x0 0x0 0x0 0x0 0x2c 0x1 0x0 0x0 0x1 0x0 0x0 0x2d 0x1 0x1 0x1 0x0 0x0 0x0 0x2e 0x0 0x0 0x0 0x1 0x0 0x0 0x2f 0x1 0x0 0x0 0x0 0x0 0x0 0x30 0x1 0x0 0x0 0x1 0x1 0x1 0x31 0x1 0x0 0x0 0x1 0x1 0x1 0x32 0x1 0x0 0x0 0x1 0x1 0x1 0x33 0x1 0x0 0x0 0x1 0x1 0x1 0x34 0x1 0x1 0x0 0x1 0x0 0x0 0x35 0x1 0x1 0x0 0x1 0x0 0x0 0x36 0x1 0x1 0x0 0x1 0x0 0x0 0x37 0x1 0x1 0x0 0x1 0x0 0x0 0x38 0x1 0x1 0x0 0x1 0x0 0x0 0x39 0x1 0x1 0x0 0x1 0x0 0x0 0x3a 0x0 0x0 0x0 0x1 0x0 0x0 0x3b 0x1 0x0 0x0 0x1 0x0 0x0 0x3c 0x1 0x0 0x0 0x1 0x0 0x0 0x3d 0x1 0x0 0x0 0x1 0x0 0x0 0x3e 0x1 0x0 0x0 0x1 0x0 0x0 0x3f 0x1 0x0 0x0 0x1 0x0 0x0 0x40 0x1 0x0 0x0 0x1 0x0 0x0 0x41 0x1 0x0 0x0 0x1 0x0 0x0 0x42 0x1 0x0 0x0 0x1 0x0 0x0 0x43 0x1 0x0 0x0 0x1 0x0 0x0 0x44 0x1 0x0 0x0 0x1 0x0 0x0 0x45 0x1 0x1 0x0 0x1 0x0 0x0 0x46 0x0 0x0 0x0 0x1 0x0 0x0 0x47 0x0 0x0 0x0 0x1 0x0 0x0 0x48 0x0 0x0 0x0 0x1 0x0 0x0 0x49 0x1 0x1 0x0 0x1 0x0 0x0 0x4a 0x1 0x1 0x0 0x1 0x0 0x0 0x4b 0x1 0x1 0x0 0x1 0x0 0x0 0x4c 0x1 0x1 0x0 0x1 0x0 0x0 0x4d 0x1 0x1 0x0 0x1 0x0 0x0 0x4e 0x0 0x1 0x0 0x1 0x0 0x0 0x4f 0x1 0x0 0x0 0x1 0x0 0x0 0x50 0x1 0x0 0x0 0x1 0x0 0x0 0x51 0x1 0x0 0x0 0x1 0x1 0x1 0x52 0x1 0x0 0x0 0x1 0x1 0x1 0x53 0x1 0x0 0x0 0x1 0x1 0x1 0x54 0x1 0x0 0x0 0x1 0x1 0x1 0x55 0x1 0x1 0x0 0x1 0x0 0x0 0x56 0x1 0x1 0x0 0x1 0x0 0x0 0x57 0x0 0x1 0x1 0x0 0x0 0x0 0x58 0x0 0x1 0x0 0x1 0x0 0x0 0x59 0x1 0x0 0x0 0x1 0x0 0x0 0x5a 0x2 0x1 0x0 0x0 0x0 0x0 0x5b 0x0 0x0 0x0 0x1 0x0 0x0 0x5c 0x1 0x1 0x0 0x0 0x0 0x0 0x5d 0x1 0x0 0x0 0x1 0x1 0x0 0x5e 0x1 0x0 0x0 0x1 0x1 0x0 0x5f 0x1 0x0 0x0 0x1 0x1 0x0 0x60 0x1 0x1 0x0 0x0 0x0 0x0 0x61 0x0 0x1 0x0 0x0 0x0 0x0 0x62 0x0 0x1 0x0 0x0 0x0 0x0 0x63 0x1 0x1 0x0 0x0 0x0 0x0 0x64 0x1 0x1 0x0 0x0 0x0 0x0 0x65 0x0 0x1 0x1 0x0 0x0 0x0 0x66 0x0 0x1 0x1 0x0 0x0 0x0 0x67 0x1 0x0 0x0 0x1 0x1 0x1 0x68 0x1 0x0 0x0 0x1 0x1 0x1 0x69 0x1 0x0 0x0 0x1 0x1 0x1 0x6a 0x1 0x0 0x0 0x1 0x1 0x1 0x6b 0x2 0x1 0x0 0x0 0x0 0x0 0x6c 0x1 0x1 0x0 0x0 0x0 0x0 0x6d 0x2 0x0 0x0 0x1 0x1 0x0 0x6e 0x0 0x0 0x0 0x1 0x0 0x0 0x6f 0x0 0x0 0x0 0x1 0x0 0x0 0x70 0x0 0x0 0x0 0x1 0x0 0x0 0x71 0x0 0x0 0x0 0x1 0x0 0x0 0x72 0x0 0x0 0x0 0x1 0x0 0x0 0x73 0x0 0x0 0x0 0x1 0x0 0x0 0x74 0x0 0x0 0x0 0x1 0x0 0x0 0x75 0x0 0x0 0x0 0x1 0x0 0x0 0x76 0x0 0x0 0x0 0x1 0x0 0x0 0x77 0x0 0x0 0x0 0x1 0x0 0x0 0x78 0x0 0x0 0x0 0x1 0x0 0x0 0x79 0x0 0x0 0x0 0x1 0x0 0x0 0x7a 0x1 0x0 0x0 0x1 0x1 0x1 0x7b 0x1 0x0 0x0 0x1 0x1 0x1 0x7c 0x1 0x1 0x0 0x0 0x0 0x1 0x7d 0x1 0x0 0x0 0x1 0x1 0x1 0x7e 0x1 0x0 0x0 0x1 0x1 0x1 0x7f 0x1 0x0 0x0 0x1 0x1 0x1 0x80 0x1 0x0 0x0 0x1 0x1 0x1 0x81 0x1 0x0 0x0 0x1 0x1 0x1 0x82 0x1 0x0 0x0 0x1 0x1 0x1 0x83 0x1 0x0 0x0 0x1 0x0 0x1 0x84 0x1 0x0 0x0 0x1 0x1 0x1 0x85 0x1 0x1 0x1 0x0 0x0 0x1 0x86 0x1 0x0 0x0 0x1 0x0 0x1 0x87 0x1 0x1 0x0 0x0 0x0 0x0 0x88 0x1 0x1 0x0 0x0 0x0 0x0 0x89 0x1 0x1 0x0 0x0 0x0 0x0 0x8a 0x1 0x1 0x0 0x0 0x0 0x0 0x8b 0x1 0x1 0x0 0x0 0x0 0x0 0x8c 0x1 0x0 0x0 0x1 0x0 0x0 0x8d 0x1 0x0 0x0 0x1 0x0 0x0 0x8e 0x1 0x0 0x0 0x1 0x0 0x0 0x8f 0x1 0x0 0x0 0x1 0x0 0x0 0x90 0x1 0x0 0x0 0x1 0x0 0x0 0x91 0x1 0x1 0x1 0x0 0x0 0x0 0x92 0x1 0x0 0x0 0x1 0x0 0x0 0x93 0x1 0x1 0x0 0x0 0x0 0x0 0x94 0x1 0x1 0x0 0x0 0x0 0x0 0x95 0x1 0x1 0x0 0x0 0x0 0x0 0x96 0x6 0x0 0x0 0x1 0x1 0x0 0x97 0x6 0x1 0x0 0x0 0x0 0x0 0x98 0x5 0x0 0x0 0x1 0x1 0x0 0x99 0x5 0x1 0x0 0x0 0x0 0x0 0x9a 0x0 0x1 0x0 0x1 0x0 0x0 0x9b 0x1 0x0 0x0 0x1 0x0 0x0 0x9c 0x1 0x1 0x0 0x0 0x0 0x0 0x9d 0x1 0x1 0x0 0x0 0x0 0x0 0x9e 0x1 0x1 0x0 0x0 0x0 0x0 0x9f 0x0 0x1 0x0 0x0 0x0 0x0 0xa0 0x0 0x1 0x0 0x0 0x0 0x0 0xa1 0x1 0x0 0x0 0x1 0x1 0x1 0xa2 0x1 0x0 0x0 0x1 0x1 0x1 0xa3 0x0 0x0 0x0 0x0 0x0 0x0 0xa4 0x0 0x0 0x0 0x0 0x0 0x0 0xa5 0x0 0x0 0x0 0x1 0x0 0x0 0xa6 0x0 0x0 0x0 0x1 0x0 0x0 0xa7 0x0 0x0 0x0 0x1 0x0 0x0 0xa8 0x0 0x0 0x0 0x1 0x0 0x0 0xa9 0x0 0x1 0x0 0x0 0x0 0x0 0xaa 0x0 0x1 0x0 0x0 0x0 0x0 0xab 0x0 0x0 0x0 0x1 0x0 0x0 0xac 0x0 0x1 0x1 0x0 0x0 0x0 0xad 0x0 0x1 0x0 0x0 0x0 0x0 0xae 0x0 0x1 0x1 0x0 0x0 0x0 0xaf 0x0 0x1 0x0 0x0 0x0 0x0 0xb0 0x0 0x1 0x0 0x0 0x0 0x0 0xb1 0x0 0x1 0x0 0x0 0x0 0x0 0xb2 0x0 0x1 0x0 0x0 0x0 0x0 0xb3 0x0 0x0 0x0 0x1 0x0 0x0>;
		};
	};

	fragment@52 {
		target = <0xffffffff>;

		__overlay__ {
			interrupt-parent = <0xffffffff>;
			interrupts = <0x0 0x2 0x0 0x0>;
			status = "okay";
		};
	};

	fragment@53 {
		target = <0xffffffff>;

		__overlay__ {
			interrupt-parent = <0xffffffff>;
			interrupts = <0x1 0x2 0x1 0x0>;
			status = "okay";
		};
	};

	fragment@54 {
		target = <0xffffffff>;

		__overlay__ {
			deb-gpios = <0xffffffff 0x2 0x0>;
			debounce = <0x7d000>;
			interrupt-parent = <0xffffffff>;
			interrupts = <0x2 0x8 0x2 0x0>;
			status = "okay";
		};
	};

	fragment@55 {
		target = <0xffffffff>;

		__overlay__ {
			interrupt-parent = <0xffffffff>;
			interrupts = <0x3 0x8 0x3 0x0>;
			status = "okay";
		};
	};

	fragment@56 {
		target = <0xffffffff>;

		__overlay__ {
			interrupt-parent = <0xffffffff>;
			interrupts = <0x7 0x4 0x7 0x0>;
			status = "okay";
		};
	};

	fragment@57 {
		target = <0xffffffff>;

		__overlay__ {
			deb-gpios = <0xffffffff 0x9 0x0>;
			debounce = <0x3e800>;
			interrupt-parent = <0xffffffff>;
			interrupts = <0x9 0x8 0x9 0x0>;
			status = "okay";
		};
	};

	fragment@58 {
		target = <0xffffffff>;

		__overlay__ {
			interrupt-parent = <0xffffffff>;
			interrupts = <0xa 0x4 0xa 0x0>;
			status = "okay";
		};
	};

	fragment@59 {
		target = <0xffffffff>;

		__overlay__ {
			interrupt-parent = <0xffffffff>;
			interrupts = <0xb 0x2 0xb 0x0>;
			status = "okay";
		};
	};

	fragment@6 {
		target = <0xffffffff>;

		__overlay__ {
			pinctrl-0 = <0x5>;
			pinctrl-names = "default";
		};
	};

	fragment@60 {
		target = <0xffffffff>;

		__overlay__ {
			interrupt-parent = <0xffffffff>;
			interrupts = <0x17 0x8 0x17 0x0>;
			status = "okay";
		};
	};

	fragment@61 {
		target = <0xffffffff>;

		__overlay__ {
			interrupt-parent = <0xffffffff>;
			interrupts = <0x29 0x2 0x29 0x0>;
			status = "okay";
		};
	};

	fragment@62 {
		target = <0xffffffff>;

		__overlay__ {
			interrupt-parent = <0xffffffff>;
			interrupts = <0x2c 0x1 0x2c 0x1>;
			status = "okay";
		};
	};

	fragment@63 {
		target = <0xffffffff>;

		__overlay__ {
			interrupt-parent = <0xffffffff>;
			interrupts = <0x90 0x4 0x90 0x1>;
			status = "okay";
		};
	};

	fragment@64 {
		target = <0xffffffff>;

		__overlay__ {
			compatible = "mediatek,md1_sim1_hot_plug_eint-eint";
			debounce = <0x0 0x2710>;
			dedicated = <0x0 0x0>;
			interrupts = <0x0 0x8>;
			sockettype = <0x0 0x0>;
			src_pin = <0x0 0x1>;
			status = "okay";
		};
	};

	fragment@65 {
		target = <0xffffffff>;

		__overlay__ {
			regulator-default-on = <0x1>;
			regulator-name = "vcama";
			status = "okay";
		};
	};

	fragment@66 {
		target = <0xffffffff>;

		__overlay__ {
			regulator-default-on = <0x1>;
			regulator-name = "vsim1";
			status = "okay";
		};
	};

	fragment@67 {
		target = <0xffffffff>;

		__overlay__ {
			regulator-default-on = <0x1>;
			regulator-name = "vsim2";
			status = "okay";
		};
	};

	fragment@68 {
		target = <0xffffffff>;

		__overlay__ {
			regulator-default-on = <0x1>;
			regulator-name = "vcamd";
			status = "okay";
		};
	};

	fragment@69 {
		target = <0xffffffff>;

		__overlay__ {
			regulator-default-on = <0x1>;
			regulator-name = "vcamio";
			status = "okay";
		};
	};

	fragment@7 {
		target = <0xffffffff>;

		__overlay__ {

			kpdgpiodefault {
				phandle = <0x5>;

				pins_cmd_dat {
					bias-pull-up = <0x66>;
					input-schmitt-enable;
					output-low;
					pinmux = <0x5d01>;
				};
			};
		};
	};

	fragment@70 {
		target = <0xffffffff>;

		__overlay__ {
			regulator-default-on = <0x1>;
			regulator-name = "vldo28";
			status = "okay";
		};
	};

	fragment@71 {
		target = <0xffffffff>;

		__overlay__ {
			status = "okay";
			vcama-supply = <0xffffffff>;
			vcamaf-supply = <0xffffffff>;
			vcamaf_main2-supply = <0xffffffff>;
			vcamaf_sub-supply = <0xffffffff>;
			vcamd_main2-supply = <0xffffffff>;
			vcamio-supply = <0xffffffff>;
			vcamio_main2-supply = <0xffffffff>;
			vcamio_sub-supply = <0xffffffff>;
		};
	};

	fragment@72 {
		target = <0xffffffff>;

		__overlay__ {
			status = "okay";
			vtouch-supply = <0xffffffff>;
		};
	};

	fragment@73 {
		target = <0xffffffff>;

		__overlay__ {
			mediatek,kpd-hw-dl-key0 = <0x0>;
			mediatek,kpd-hw-dl-key1 = <0x1>;
			mediatek,kpd-hw-dl-key2 = <0x8>;
			mediatek,kpd-hw-factory-key = <0x1>;
			mediatek,kpd-hw-init-map = <0x73 0x72 0x0 0x0 0x0 0x0 0x0 0x0 0x0 0x0 0x0 0x0 0x0 0x0 0x0 0x0 0x0 0x0 0x0 0x0 0x0 0x0 0x0 0x0 0x0 0x0 0x0 0x0 0x0 0x0 0x0 0x0 0x0 0x0 0x0 0x0 0x0 0x0 0x0 0x0 0x0 0x0 0x0 0x0 0x0 0x0 0x0 0x0 0x0 0x0 0x0 0x0 0x0 0x0 0x0 0x0 0x0 0x0 0x0 0x0 0x0 0x0 0x0 0x0 0x0 0x0 0x0 0x0 0x0 0x0 0x0 0x0>;
			mediatek,kpd-hw-map-num = <0x48>;
			mediatek,kpd-hw-pwrkey = <0x8>;
			mediatek,kpd-hw-recovery-key = <0x0>;
			mediatek,kpd-hw-rstkey = <0x11>;
			mediatek,kpd-key-debounce = <0x400>;
			mediatek,kpd-pwkey-gpio-din = <0x0>;
			mediatek,kpd-pwrkey-eint-gpio = <0x0>;
			mediatek,kpd-sw-pwrkey = <0x74>;
			mediatek,kpd-sw-rstkey = <0x66>;
			mediatek,kpd-use-extend-type = <0x0>;
			status = "okay";
		};
	};

	fragment@8 {
		target = <0xffffffff>;

		__overlay__ {

			pmic_accdet {
				accdet-mic-mode = <0x1>;
				accdet-mic-vol = <0x6>;
				accdet-name = "mt63xx-accdet";
				accdet-plugout-debounce = <0x1>;
				compatible = "mediatek,mt6357-accdet";
				gpio_headset_usb_switch_pin = <0xffffffff 0xb0 0x0>;
				gpio_mic_switch_pin = <0xffffffff 0xaf 0x0>;
				headset-eint-level-pol = <0x8>;
				headset-eint-num = <0x0>;
				headset-eint-trig-mode = <0x0>;
				headset-four-key-threshold = <0x0 0x3a 0x79 0xc0 0x190>;
				headset-key-mode = <0x0>;
				headset-mode-setting = <0x500 0x500 0x1 0x1f0 0x800 0x800 0x20 0x44>;
				headset-three-key-threshold = <0x0 0x50 0xdc 0x190>;
				headset-three-key-threshold-CDD = <0x0 0x79 0xc0 0x258>;
				headset-use-ap-eint = <0x0>;
				phandle = <0x4f>;
				status = "okay";
			};
		};
	};

	fragment@9 {
		target = <0xffffffff>;

		__overlay__ {
			accdet-mic-mode = <0x1>;
			accdet-mic-vol = <0x6>;
			accdet-plugout-debounce = <0x1>;
			headset-eint-level-pol = <0x8>;
			headset-four-key-threshold = <0x0 0x3a 0x79 0xc0 0x190>;
			headset-mode-setting = <0x500 0x500 0x1 0x1f0 0x800 0x800 0x20 0x44>;
			headset-three-key-threshold = <0x0 0x50 0xdc 0x190>;
			headset-three-key-threshold-CDD = <0x0 0x79 0xc0 0x258>;
			pinctrl-0 = <0x6>;
			pinctrl-1 = <0x7>;
			pinctrl-names = "default", "state_eint_as_int";
			status = "okay";
		};
	};
};
